## config/boards/arm/keypoint_dongle/dts/bindings/zmk,behavior-mouse-scroll-tick.yaml
```yaml
# Copyright (c) 2025 ZitaoTech / ZMK Contributors
# SPDX-License-Identifier: MIT

description: Mouse scroll tick behavior

compatible: "zmk,behavior-mouse-scroll-tick"

include: one_param.yaml
```

## config/boards/arm/keypoint_dongle/dts/bindings/zmk,input-processor-layer-scroll.yaml
```yaml
# Copyright (c) 2025 ZitaoTech / ZMK Contributors
# SPDX-License-Identifier: MIT

description: Input processor to convert cursor movement into scroll wheel events for a specific layer

compatible: "zmk,input-processor-layer-scroll"

include: ip_two_param.yaml
```
